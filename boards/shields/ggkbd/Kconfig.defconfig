## boards/shields/ggkbd/Kconfig.defconfig
```kconfig
if SHIELD_GGKBD_LEFT

config ZMK_KEYBOARD_NAME
    default "ggkbd"

config ZMK_SPLIT_ROLE_CENTRAL
    default y

endif

if SHIELD_GGKBD_LEFT || SHIELD_GGKBD_RIGHT

config ZMK_SPLIT
    default y

endif
```

## boards/shields/ggkbd/Kconfig.shield
```kconfig
config SHIELD_GGKBD_LEFT
    def_bool $(shields_list_contains,ggkbd_left)

config SHIELD_GGKBD_RIGHT
    def_bool $(shields_list_contains,ggkbd_right)
```
